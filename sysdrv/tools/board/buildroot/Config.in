## sysdrv/tools/board/buildroot/Config.in
```kconfig
source "$BR2_EXTERNAL_LUCKFOX_PATH/external-packages/ccid-sec1210/Config.in"
source "$BR2_EXTERNAL_LUCKFOX_PATH/external-packages/ifdnfc/Config.in"
source "$BR2_EXTERNAL_LUCKFOX_PATH/external-packages/libraqm/Config.in"
source "$BR2_EXTERNAL_LUCKFOX_PATH/external-packages/nfc-bindings/Config.in"
source "$BR2_EXTERNAL_LUCKFOX_PATH/external-packages/openct/Config.in"
source "$BR2_EXTERNAL_LUCKFOX_PATH/external-packages/python-embit/Config.in"
source "$BR2_EXTERNAL_LUCKFOX_PATH/external-packages/python-mnemonic/Config.in"
source "$BR2_EXTERNAL_LUCKFOX_PATH/external-packages/python-mock/Config.in"
source "$BR2_EXTERNAL_LUCKFOX_PATH/external-packages/python-pgpy/Config.in"
source "$BR2_EXTERNAL_LUCKFOX_PATH/external-packages/python-picamera/Config.in"
source "$BR2_EXTERNAL_LUCKFOX_PATH/external-packages/python-pillow-ep/Config.in"
source "$BR2_EXTERNAL_LUCKFOX_PATH/external-packages/python-pysatochip/Config.in"
source "$BR2_EXTERNAL_LUCKFOX_PATH/external-packages/python-pyscard/Config.in"
source "$BR2_EXTERNAL_LUCKFOX_PATH/external-packages/python-pyzbar/Config.in"
source "$BR2_EXTERNAL_LUCKFOX_PATH/external-packages/python-shamir-mnemonic/Config.in"
source "$BR2_EXTERNAL_LUCKFOX_PATH/external-packages/python-smbus2/Config.in"
source "$BR2_EXTERNAL_LUCKFOX_PATH/external-packages/python-urtypes/Config.in"
```

## sysdrv/tools/board/buildroot/luckfox_pico_defconfig
```kconfig
BR2_arm=y
BR2_cortex_a7=y
BR2_TOOLCHAIN_BUILDROOT_GLIBC=y
BR2_TOOLCHAIN_BUILDROOT_CXX=y
BR2_GCC_VERSION_13_X=y
BR2_TOOLCHAIN_BUILDROOT_WCHAR=y
BR2_PACKAGE_HOST_GDB=y
BR2_PRIMARY_SITE="http://sources.buildroot.net"
BR2_OPTIMIZE_3=y
BR2_TARGET_GENERIC_HOSTNAME="luckfox pico"
BR2_TARGET_GENERIC_ISSUE="Welcome to luckfox pico"
BR2_TARGET_GENERIC_ROOT_PASSWD="luckfox"
BR2_SYSTEM_ENABLE_NLS=y
BR2_PACKAGE_BUSYBOX_SHOW_OTHERS=y
BR2_PACKAGE_E2FSPROGS=y
BR2_PACKAGE_E2FSPROGS_RESIZE2FS=y
BR2_PACKAGE_EVTEST=y
BR2_PACKAGE_PYTHON3=y
BR2_PACKAGE_PYTHON3_SSL=y
BR2_PACKAGE_PYTHON3_BZIP2=y
BR2_PACKAGE_PYTHON_AIOHTTP=y
BR2_PACKAGE_PYTHON_CLICK=y
BR2_PACKAGE_PYTHON_ECDSA=y
BR2_PACKAGE_PYTHON_EMBIT=y
BR2_PACKAGE_PYTHON_ITSDANGEROUS=y
BR2_PACKAGE_PYTHON_JINJA2=y
BR2_PACKAGE_PYTHON_MNEMONIC=y
BR2_PACKAGE_PYTHON_MOCK=y
BR2_PACKAGE_PYTHON_NUMPY=y
BR2_PACKAGE_PYTHON_PERIPHERY=y
BR2_PACKAGE_PYTHON_PGPY=y
BR2_PACKAGE_PYTHON_PILLOW=y
BR2_PACKAGE_PYTHON_PILLOW_EP=y
BR2_PACKAGE_PYTHON_PYAES=y
BR2_PACKAGE_PYTHON_PYASN1=y
BR2_PACKAGE_PYTHON_PYCRYPTODOMEX=y
BR2_PACKAGE_PYTHON_PYQRCODE=y
BR2_PACKAGE_PYTHON_PYSATOCHIP=y
BR2_PACKAGE_PYTHON_PYSCARD=y
BR2_PACKAGE_PYTHON_PYZBAR=y
BR2_PACKAGE_PYTHON_QRCODE=y
BR2_PACKAGE_PYTHON_SERIAL=y
BR2_PACKAGE_PYTHON_SETUPTOOLS=y
BR2_PACKAGE_PYTHON_SHAMIR_MNEMONIC=y
BR2_PACKAGE_PYTHON_SMBUS2=y
BR2_PACKAGE_PYTHON_SMBUS_CFFI=y
BR2_PACKAGE_PYTHON_SPIDEV=y
BR2_PACKAGE_PYTHON_URTYPES=y
BR2_PACKAGE_PYTHON_WERKZEUG=y
BR2_PACKAGE_GNUTLS=y
BR2_PACKAGE_LIBMD=y
BR2_PACKAGE_FREETYPE=y
BR2_PACKAGE_LIBRAQM=y
BR2_PACKAGE_LIBDRM=y
BR2_PACKAGE_DTC=y
BR2_PACKAGE_DTC_PROGRAMS=y
BR2_PACKAGE_LIBV4L=y
BR2_PACKAGE_LIBV4L_UTILS=y
BR2_PACKAGE_LIBQRENCODE=y
BR2_PACKAGE_LIBQRENCODE_TOOLS=y
BR2_PACKAGE_LIBRSYNC=y
BR2_PACKAGE_ZBAR=y
BR2_PACKAGE_PCRE2=y
BR2_PACKAGE_PCRE2_16=y
BR2_PACKAGE_PCRE2_32=y
BR2_PACKAGE_IPERF=y
BR2_PACKAGE_IPERF3=y
BR2_PACKAGE_LRZSZ=y
BR2_PACKAGE_NTP=y
BR2_PACKAGE_OPENSSH=y
BR2_PACKAGE_RSYNC=y
BR2_PACKAGE_SOCAT=y
BR2_PACKAGE_BASH=y
BR2_PACKAGE_BASH_LOADABLE_EXAMPLES=y
BR2_PACKAGE_DIALOG=y
BR2_PACKAGE_TIME=y
BR2_PACKAGE_HTOP=y
BR2_PACKAGE_UTIL_LINUX_LIBMOUNT=y
BR2_PACKAGE_NANO=y
BR2_PACKAGE_CCID=y
BR2_PACKAGE_CCID_SEC1210=y
BR2_PACKAGE_GNUPG2=y
BR2_PACKAGE_PINENTRY=y
BR2_PACKAGE_PINENTRY_NCURSES=y
BR2_PACKAGE_P7ZIP=y
BR2_PACKAGE_P7ZIP_7ZA=y
BR2_PACKAGE_RNG_TOOLS=y
BR2_PACKAGE_SPI_TOOLS=y
BR2_PACKAGE_IFDNFC=y
BR2_PACKAGE_NFC_BINDINGS=y
BR2_PACKAGE_OPENCT=y
BR2_PACKAGE_HOST_DTC=y
```
